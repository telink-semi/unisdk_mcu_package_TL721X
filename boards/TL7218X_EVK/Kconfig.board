## boards/TL7218X_EVK/Kconfig.board
```kconfig
choice TLK_BOARD_CHOICE

config TLK_BOARD_TL7218X_EVK
    bool "TL7218X_EVK"
    depends on TLK_SOC_TL7218X

endchoice

config TLK_BOARD
    default "TL7218X_EVK" if TLK_BOARD_TL7218X_EVK
```

## core/drivers/Kconfig.core
```kconfig
config TLK_CORE_TL721X
    bool

config TLK_CORE
    default "TL721X" if TLK_CORE_TL721X

orsource "soc/*/Kconfig.soc"
orsource "boards/*/Kconfig.board"
```

## kconfig/TL721X/TL7218X_EVK/core/configs/Kconfig.adc
```kconfig
menuconfig TLK_ADC
    bool "ADC"
    select TLK_GPIO


if TLK_ADC

config TLK_ADC_DMA
    bool "Enable DMA support"
    select TLK_DMA

if TLK_PM

config TLK_ADC_PM_DEVICE
    bool "Enable PM support"
    default y

endif # TLK_PM

endif # TLK_ADC
```

## kconfig/TL721X/TL7218X_EVK/core/configs/Kconfig.common
```kconfig
menuconfig TLK_CRITICAL_PRINT
    bool "Enable critical printout"
    select TLK_UART


if TLK_CRITICAL_PRINT

choice
    prompt "UART number"

config TLK_CRITICAL_PRINT_UART0
    bool "UART0"
    select TLK_UART0
config TLK_CRITICAL_PRINT_UART1
    bool "UART1"
    select TLK_UART1
config TLK_CRITICAL_PRINT_UART2
    bool "UART2"
    select TLK_UART2

endchoice # UART number


config TLK_CRITICAL_PRINT_UART
    string
    default TLK_UART0 if TLK_CRITICAL_PRINT_UART0
    default TLK_UART1 if TLK_CRITICAL_PRINT_UART1
    default TLK_UART2 if TLK_CRITICAL_PRINT_UART2


config TLK_CRITICAL_PRINT_UART_BAUDRATE
    int "Baudrate"
    default 115200

endif # TLK_CRITICAL_PRINT

############################################################## TODO: review

config TLK_BINARY_SIGNATURE_ADDRESS
    hex
    default 0x100

config TLK_BINARY_SIGNATURE_CORE_NAME_SIZE
    int
    default 16

config TLK_BINARY_SIGNATURE_SOC_NAME_SIZE
    int
    default 16

config TLK_BINARY_SIGNATURE_SOC_CASE_NAME_SIZE
    int
    default 16

config TLK_BINARY_SIGNATURE_SDK_VERSION_SIZE
    int
    default 48

config TLK_BINARY_SIGNATURE_APP_VERSION_SIZE
    int
    default 48
```

## kconfig/TL721X/TL7218X_EVK/core/configs/Kconfig.dma
```kconfig
menuconfig TLK_DMA
    bool "DMA"


if TLK_DMA

config TLK_DMA_IRQ
    bool "Enable IRQ Support"
    depends on TLK_PLIC


if TLK_PM

config TLK_DMA_PM_DEVICE
    default y
    bool "Enable PM Support"

config TLK_DMA_PREVENT_SLEEP
    bool "Prevent sleep if DMA channels busy"

endif # TLK_PM

endif # TLK_DMA
```

## kconfig/TL721X/TL7218X_EVK/core/configs/Kconfig.i2s
```kconfig
menuconfig TLK_I2S
    bool "I2S"
    select TLK_GPIO
    select TLK_DMA


if TLK_I2S

config TLK_I2S_USE_DEVICE
    def_bool n


menuconfig TLK_I2S0
    bool "I2S0"
    select TLK_I2S_USE_DEVICE

menuconfig TLK_I2S1
    bool "I2S1"
    select TLK_I2S_USE_DEVICE

menuconfig TLK_I2S2
    bool "I2S2"
    select TLK_I2S_USE_DEVICE

endif # TLK_I2S
```

## kconfig/TL721X/TL7218X_EVK/core/configs/Kconfig.plic
```kconfig
menuconfig TLK_PLIC
    bool "PLIC"


if TLK_PLIC

config TLK_PLIC_VECTOR_MODE
    bool "Enable vector mode"
    default y


menu "Interrupts nesting"

config TLK_PLIC_USE_NEST
    bool
    default n


config TLK_PLIC_NEST_PLIC_SW
    bool "Nest machine software interrupt (MSIE)"
    select TLK_PLIC_USE_NEST
    depends on TLK_PLIC_SW


config TLK_PLIC_NEST_MTIMER
    bool "Nest machine timer interrupt (MTIE)"
    select TLK_PLIC_USE_NEST
    depends on TLK_MTIMER_IRQ


config TLK_PLIC_NEST_PLIC
    bool "Nest external interrupts (MEIE)"
    select TLK_PLIC_USE_NEST

endmenu

endif # TLK_PLIC
```

## kconfig/TL721X/TL7218X_EVK/core/configs/Kconfig.plicsw
```kconfig
menuconfig TLK_PLIC_SW
    bool "SW PLIC"


if TLK_PLIC_SW

config TLK_PLIC_SW_USE_NEST
    bool
    default n


config TLK_PLIC_SW_NEST_PLIC_SW
    bool "Nest machine software interrupt (MSIE)"
    select TLK_PLIC_SW_USE_NEST


config TLK_PLIC_SW_NEST_MTIMER
    bool "Nest machine timer interrupt (MTIE)"
    select TLK_PLIC_SW_USE_NEST
    depends on TLK_MTIMER_IRQ


config TLK_PLIC_SW_NEST_PLIC
    bool "Nest external interrupts (MEIE)"
    select TLK_PLIC_SW_USE_NEST
    depends on TLK_PLIC

endif # TLK_PLIC_SW
```

## kconfig/TL721X/TL7218X_EVK/core/configs/Kconfig.trap
```kconfig
menu "TRAP"

config TLK_TRAP_ECALL_NEST
    bool "Enable nesting into the ecall exception"

endmenu
```
