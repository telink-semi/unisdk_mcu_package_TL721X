## kconfig/TL721X/core/configs/Kconfig.mtimer
```kconfig
menuconfig TLK_MTIMER
    bool "MTIMER"


if TLK_MTIMER

menuconfig TLK_MTIMER_IRQ
    bool "Enable interrupts"


if TLK_MTIMER_IRQ

config TLK_MTIMER_IRQ_USE_NEST
    bool
    default n


config TLK_MTIMER_IRQ_NEST_PLIC_SW
    bool "Nest machine software interrupt (MSIE)"
    select TLK_MTIMER_IRQ_USE_NEST
    depends on TLK_PLIC_SW


config TLK_MTIMER_IRQ_NEST_PLIC
    bool "Nest external interrupts (MEIE)"
    select TLK_MTIMER_IRQ_USE_NEST
    depends on TLK_PLIC

endif # TLK_MTIMER_IRQ

endif # TLK_MTIMER
```

## kconfig/TL721X/core/configs/Kconfig.stimer
```kconfig
menu "STIMER"

config TLK_STIMER_AUTO_MODE
    bool "Enable system timer auto mode"
    default y

config TLK_STIMER_IRQ
    bool "Enable system timer interrupt"
    default n
    select TLK_PLIC


if TLK_PM

config TLK_STIMER_PM_DEVICE
    bool "Enable PM Support"
    default y

endif # TLK_PM

config TLK_STIMER_ADVANCED_MODE
    bool "Enable system timer advanced modes"

config TLK_STIMER_ADVANCED_USE_32K_TICK_ANALOG_READOUT
    bool "Enable 32K tick analog readout"
    depends on TLK_STIMER_ADVANCED_MODE
    default y

endmenu
```
