## kconfig/TL721X/TL7218X_EVK/core/configs/Kconfig.uart
```kconfig
menuconfig TLK_UART
    bool "UART"
    select TLK_GPIO
    select TLK_PLIC      # For basic UART RX
    select TLK_API_TIME  # For basic UART TX


if TLK_UART

config TLK_UART_USE_DEVICE
    def_bool n

config TLK_UART_USE_BLOCKING
    bool

config TLK_UART_USE_IRQ
    bool

config TLK_UART_USE_DMA
    bool


config TLK_UART_USE_AUTO_CONFIG
    bool

config TLK_UART_USE_PM_DEVICE
    bool

config TLK_UART_USE_FLOW_CONTROL
    bool



config TLK_UART0_USE_IRQ
    bool
    select TLK_UART_USE_IRQ

config TLK_UART0_USE_DMA
    bool
    select TLK_UART_USE_DMA


menuconfig TLK_UART0
    bool "Enable UART0"
    select TLK_UART_USE_DEVICE


if TLK_UART0

menuconfig TLK_UART0_AUTO_CONFIG
    bool "Configure automatically"
    select TLK_UART_USE_AUTO_CONFIG


if TLK_UART0_AUTO_CONFIG

config TLK_UART0_AC_BAUDRATE
    int "Baudrate"
    default 115200


choice
    prompt "Parity"
    default TLK_UART0_AC_PARITY_NONE

config TLK_UART0_AC_PARITY_NONE
    bool "None"

config TLK_UART0_AC_PARITY_EVEN
    bool "Even"

config TLK_UART0_AC_PARITY_ODD
    bool "Odd"

endchoice # Parity


config TLK_UART0_AC_PARITY
    string
    default "TLK_UART_PARITY_NONE" if TLK_UART0_AC_PARITY_NONE
    default "TLK_UART_PARITY_EVEN" if TLK_UART0_AC_PARITY_EVEN
    default "TLK_UART_PARITY_ODD" if TLK_UART0_AC_PARITY_ODD


choice
    prompt "Stop bit"
    default TLK_UART0_AC_STOP_BIT_ONE

config TLK_UART0_AC_STOP_BIT_ONE
    bool "One"

config TLK_UART0_AC_STOP_BIT_ONE_DOT_FIVE
    bool "One dot five"

config TLK_UART0_AC_STOP_BIT_TWO
    bool "Two"

endchoice # Stop bit


config TLK_UART0_AC_STOP_BIT
    string
    default "TLK_UART_STOP_BIT_ONE" if TLK_UART0_AC_STOP_BIT_ONE
    default "TLK_UART_STOP_BIT_ONE_DOT_FIVE" if TLK_UART0_AC_STOP_BIT_ONE_DOT_FIVE
    default "TLK_UART_STOP_BIT_TWO" if TLK_UART0_AC_STOP_BIT_TWO


if TLK_UART0_FLOW_CONTROL

choice
    prompt "Flow control"
    default TLK_UART0_AC_FLOW_CONTROL_NONE

config TLK_UART0_AC_FLOW_CONTROL_NONE
    bool "None"

config TLK_UART0_AC_FLOW_CONTROL_RTS
    bool "RTS"

config TLK_UART0_FLOW_CONTROL_CTS
    bool "CTS"

config TLK_UART0_AC_AC_FLOW_CONTROL_RTS_CTS
    bool "RTS_CTS"

endchoice # Flow control


config TLK_UART0_AC_FLOW_CONTROL_TYPE
    string
    default "TLK_UART_FLOW_NONE" if TLK_UART0_AC_FLOW_CONTROL_NONE
    default "TLK_UART_FLOW_RTS" if TLK_UART0_AC_FLOW_CONTROL_RTS
    default "TLK_UART_FLOW_CTS" if TLK_UART0_FLOW_CONTROL_CTS
    default "TLK_UART_FLOW_RTS_CTS" if TLK_UART0_AC_AC_FLOW_CONTROL_RTS_CTS


choice
    prompt "Flow polarity"
    default TLK_UART0_AC_FLOW_POLARITY_LOW

config TLK_UART0_AC_FLOW_POLARITY_LOW
    bool "Low"

config TLK_UART0_AC_FLOW_POLARITY_HIGH
    bool "High"

endchoice # Flow polarity


config TLK_UART0_AC_FLOW_POLARITY
    string
    default "TLK_UART_ACTIVE_LOW" if TLK_UART0_AC_FLOW_POLARITY_LOW
    default "TLK_UART_ACTIVE_HIGH" if TLK_UART0_AC_FLOW_POLARITY_HIGH

endif # TLK_UART0_FLOW_CONTROL

endif # UART0_AUTO_CONFIG


choice
    prompt "TX mode"
    default TLK_UART0_TX_BLOCKING

config TLK_UART0_TX_BLOCKING
    bool "Blocking"
    select TLK_UART_USE_BLOCKING

config TLK_UART0_TX_IRQ
    bool "Interrupt"
    select TLK_UART0_USE_IRQ
    depends on TLK_PLIC

config TLK_UART0_TX_DMA
    bool "DMA"
    select TLK_UART0_USE_DMA
    select TLK_UART0_USE_IRQ
    depends on TLK_DMA
    depends on TLK_PLIC

endchoice # TX mode


config TLK_UART0_TX_MODE
    string
    default "TLK_UART_XFER_BLOCKING" if TLK_UART0_TX_BLOCKING
    default "TLK_UART_XFER_IRQ" if TLK_UART0_TX_IRQ
    default "TLK_UART_XFER_DMA" if TLK_UART0_TX_DMA


choice
    prompt "RX mode"
    default TLK_UART0_RX_IRQ

config TLK_UART0_RX_IRQ
    bool "Interrupt"
    select TLK_UART0_USE_IRQ

config TLK_UART0_RX_DMA
    bool "DMA"
    select TLK_UART0_USE_DMA
    select TLK_UART0_USE_IRQ
    depends on TLK_DMA
    depends on TLK_PLIC

endchoice # RX mode


config TLK_UART0_RX_MODE
    string
    default "TLK_UART_XFER_BLOCKING" if TLK_UART0_RX_BLOCKING
    default "TLK_UART_XFER_IRQ" if TLK_UART0_RX_IRQ
    default "TLK_UART_XFER_DMA" if TLK_UART0_RX_DMA


if TLK_UART0_RX_DMA

choice
    prompt "RX DMA type"

config TLK_UART0_RX_DMA_FIXED
    bool "Word only"

config TLK_UART0_RX_DMA_WITH_TAIL
    bool "Word with manual tail read"
    depends on TLK_DMA_IRQ

endchoice # RX DMA type


config TLK_UART0_RX_DMA_MODE
    string
    default "TLK_UART_RX_DMA_FIXED" if TLK_UART0_RX_DMA_FIXED
    default "TLK_UART_RX_DMA_WITH_TAIL" if TLK_UART0_RX_DMA_WITH_TAIL

endif # TLK_UART0_RX_DMA


config TLK_UART0_FLOW_CONTROL
    bool "Use flow control"
    select TLK_UART_USE_FLOW_CONTROL


config TLK_UART_RTS_TRIG_LEVEL
   int "RTS trig level"
   default 5
   range 1 8
   depends on TLK_UART0_FLOW_CONTROL


if TLK_PM

config TLK_UART0_PM_DEVICE
    bool "Enable PM Support"
    default y
    select TLK_UART_USE_PM_DEVICE

config TLK_UART0_PREVENT_SLEEP
    bool "Prevent sleep if busy"

endif # TLK_PM

endif # TLK_UART0

config TLK_UART1_USE_IRQ
    bool
    select TLK_UART_USE_IRQ

config TLK_UART1_USE_DMA
    bool
    select TLK_UART_USE_DMA


menuconfig TLK_UART1
    bool "Enable UART1"
    select TLK_UART_USE_DEVICE


if TLK_UART1

menuconfig TLK_UART1_AUTO_CONFIG
    bool "Configure automatically"
    select TLK_UART_USE_AUTO_CONFIG


if TLK_UART1_AUTO_CONFIG

config TLK_UART1_AC_BAUDRATE
    int "Baudrate"
    default 115200


choice
    prompt "Parity"
    default TLK_UART1_AC_PARITY_NONE

config TLK_UART1_AC_PARITY_NONE
    bool "None"

config TLK_UART1_AC_PARITY_EVEN
    bool "Even"

config TLK_UART1_AC_PARITY_ODD
    bool "Odd"

endchoice # Parity


config TLK_UART1_AC_PARITY
    string
    default "TLK_UART_PARITY_NONE" if TLK_UART1_AC_PARITY_NONE
    default "TLK_UART_PARITY_EVEN" if TLK_UART1_AC_PARITY_EVEN
    default "TLK_UART_PARITY_ODD" if TLK_UART1_AC_PARITY_ODD


choice
    prompt "Stop bit"
    default TLK_UART1_AC_STOP_BIT_ONE

config TLK_UART1_AC_STOP_BIT_ONE
    bool "One"

config TLK_UART1_AC_STOP_BIT_ONE_DOT_FIVE
    bool "One dot five"

config TLK_UART1_AC_STOP_BIT_TWO
    bool "Two"

endchoice # Stop bit


config TLK_UART1_AC_STOP_BIT
    string
    default "TLK_UART_STOP_BIT_ONE" if TLK_UART1_AC_STOP_BIT_ONE
    default "TLK_UART_STOP_BIT_ONE_DOT_FIVE" if TLK_UART1_AC_STOP_BIT_ONE_DOT_FIVE
    default "TLK_UART_STOP_BIT_TWO" if TLK_UART1_AC_STOP_BIT_TWO


if TLK_UART1_FLOW_CONTROL

choice
    prompt "Flow control"
    default TLK_UART1_AC_FLOW_CONTROL_NONE

config TLK_UART1_AC_FLOW_CONTROL_NONE
    bool "None"

config TLK_UART1_AC_FLOW_CONTROL_RTS
    bool "RTS"

config TLK_UART1_FLOW_CONTROL_CTS
    bool "CTS"

config TLK_UART1_AC_AC_FLOW_CONTROL_RTS_CTS
    bool "RTS_CTS"

endchoice # Flow control


config TLK_UART1_AC_FLOW_CONTROL_TYPE
    string
    default "TLK_UART_FLOW_NONE" if TLK_UART1_AC_FLOW_CONTROL_NONE
    default "TLK_UART_FLOW_RTS" if TLK_UART1_AC_FLOW_CONTROL_RTS
    default "TLK_UART_FLOW_CTS" if TLK_UART1_FLOW_CONTROL_CTS
    default "TLK_UART_FLOW_RTS_CTS" if TLK_UART1_AC_AC_FLOW_CONTROL_RTS_CTS


choice
    prompt "Flow polarity"
    default TLK_UART1_AC_FLOW_POLARITY_LOW

config TLK_UART1_AC_FLOW_POLARITY_LOW
    bool "Low"

config TLK_UART1_AC_FLOW_POLARITY_HIGH
    bool "High"

endchoice # Flow polarity


config TLK_UART1_AC_FLOW_POLARITY
    string
    default "TLK_UART_ACTIVE_LOW" if TLK_UART1_AC_FLOW_POLARITY_LOW
    default "TLK_UART_ACTIVE_HIGH" if TLK_UART1_AC_FLOW_POLARITY_HIGH

endif # TLK_UART1_FLOW_CONTROL

endif # UART1_AUTO_CONFIG


choice
    prompt "TX mode"
    default TLK_UART1_TX_BLOCKING

config TLK_UART1_TX_BLOCKING
    bool "Blocking"
    select TLK_UART_USE_BLOCKING

config TLK_UART1_TX_IRQ
    bool "Interrupt"
    select TLK_UART1_USE_IRQ
    depends on TLK_PLIC

config TLK_UART1_TX_DMA
    bool "DMA"
    select TLK_UART1_USE_DMA
    select TLK_UART1_USE_IRQ
    depends on TLK_DMA
    depends on TLK_PLIC

endchoice # TX mode


config TLK_UART1_TX_MODE
    string
    default "TLK_UART_XFER_BLOCKING" if TLK_UART1_TX_BLOCKING
    default "TLK_UART_XFER_IRQ" if TLK_UART1_TX_IRQ
    default "TLK_UART_XFER_DMA" if TLK_UART1_TX_DMA


choice
    prompt "RX mode"
    default TLK_UART1_RX_IRQ

config TLK_UART1_RX_IRQ
    bool "Interrupt"
    select TLK_UART1_USE_IRQ

config TLK_UART1_RX_DMA
    bool "DMA"
    select TLK_UART1_USE_DMA
    select TLK_UART1_USE_IRQ
    depends on TLK_DMA
    depends on TLK_PLIC

endchoice # RX mode


config TLK_UART1_RX_MODE
    string
    default "TLK_UART_XFER_BLOCKING" if TLK_UART1_RX_BLOCKING
    default "TLK_UART_XFER_IRQ" if TLK_UART1_RX_IRQ
    default "TLK_UART_XFER_DMA" if TLK_UART1_RX_DMA


if TLK_UART1_RX_DMA

choice
    prompt "RX DMA type"

config TLK_UART1_RX_DMA_FIXED
    bool "Word only"

config TLK_UART1_RX_DMA_WITH_TAIL
    bool "Word with manual tail read"
    depends on TLK_DMA_IRQ

endchoice # RX DMA type


config TLK_UART1_RX_DMA_MODE
    string
    default "TLK_UART_RX_DMA_FIXED" if TLK_UART1_RX_DMA_FIXED
    default "TLK_UART_RX_DMA_WITH_TAIL" if TLK_UART1_RX_DMA_WITH_TAIL

endif # TLK_UART1_RX_DMA


config TLK_UART1_FLOW_CONTROL
    bool "Use flow control"
    select TLK_UART_USE_FLOW_CONTROL


config TLK_UART_RTS_TRIG_LEVEL
   int "RTS trig level"
   default 5
   range 1 8
   depends on TLK_UART1_FLOW_CONTROL


if TLK_PM

config TLK_UART1_PM_DEVICE
    bool "Enable PM Support"
    default y
    select TLK_UART_USE_PM_DEVICE

config TLK_UART1_PREVENT_SLEEP
    bool "Prevent sleep if busy"

endif # TLK_PM

endif # TLK_UART1

config TLK_UART2_USE_IRQ
    bool
    select TLK_UART_USE_IRQ

config TLK_UART2_USE_DMA
    bool
    select TLK_UART_USE_DMA


menuconfig TLK_UART2
    bool "Enable UART2"
    select TLK_UART_USE_DEVICE


if TLK_UART2

menuconfig TLK_UART2_AUTO_CONFIG
    bool "Configure automatically"
    select TLK_UART_USE_AUTO_CONFIG


if TLK_UART2_AUTO_CONFIG

config TLK_UART2_AC_BAUDRATE
    int "Baudrate"
    default 115200


choice
    prompt "Parity"
    default TLK_UART2_AC_PARITY_NONE

config TLK_UART2_AC_PARITY_NONE
    bool "None"

config TLK_UART2_AC_PARITY_EVEN
    bool "Even"

config TLK_UART2_AC_PARITY_ODD
    bool "Odd"

endchoice # Parity


config TLK_UART2_AC_PARITY
    string
    default "TLK_UART_PARITY_NONE" if TLK_UART2_AC_PARITY_NONE
    default "TLK_UART_PARITY_EVEN" if TLK_UART2_AC_PARITY_EVEN
    default "TLK_UART_PARITY_ODD" if TLK_UART2_AC_PARITY_ODD


choice
    prompt "Stop bit"
    default TLK_UART2_AC_STOP_BIT_ONE

config TLK_UART2_AC_STOP_BIT_ONE
    bool "One"

config TLK_UART2_AC_STOP_BIT_ONE_DOT_FIVE
    bool "One dot five"

config TLK_UART2_AC_STOP_BIT_TWO
    bool "Two"

endchoice # Stop bit


config TLK_UART2_AC_STOP_BIT
    string
    default "TLK_UART_STOP_BIT_ONE" if TLK_UART2_AC_STOP_BIT_ONE
    default "TLK_UART_STOP_BIT_ONE_DOT_FIVE" if TLK_UART2_AC_STOP_BIT_ONE_DOT_FIVE
    default "TLK_UART_STOP_BIT_TWO" if TLK_UART2_AC_STOP_BIT_TWO


if TLK_UART2_FLOW_CONTROL

choice
    prompt "Flow control"
    default TLK_UART2_AC_FLOW_CONTROL_NONE

config TLK_UART2_AC_FLOW_CONTROL_NONE
    bool "None"

config TLK_UART2_AC_FLOW_CONTROL_RTS
    bool "RTS"

config TLK_UART2_FLOW_CONTROL_CTS
    bool "CTS"

config TLK_UART2_AC_AC_FLOW_CONTROL_RTS_CTS
    bool "RTS_CTS"

endchoice # Flow control


config TLK_UART2_AC_FLOW_CONTROL_TYPE
    string
    default "TLK_UART_FLOW_NONE" if TLK_UART2_AC_FLOW_CONTROL_NONE
    default "TLK_UART_FLOW_RTS" if TLK_UART2_AC_FLOW_CONTROL_RTS
    default "TLK_UART_FLOW_CTS" if TLK_UART2_FLOW_CONTROL_CTS
    default "TLK_UART_FLOW_RTS_CTS" if TLK_UART2_AC_AC_FLOW_CONTROL_RTS_CTS


choice
    prompt "Flow polarity"
    default TLK_UART2_AC_FLOW_POLARITY_LOW

config TLK_UART2_AC_FLOW_POLARITY_LOW
    bool "Low"

config TLK_UART2_AC_FLOW_POLARITY_HIGH
    bool "High"

endchoice # Flow polarity


config TLK_UART2_AC_FLOW_POLARITY
    string
    default "TLK_UART_ACTIVE_LOW" if TLK_UART2_AC_FLOW_POLARITY_LOW
    default "TLK_UART_ACTIVE_HIGH" if TLK_UART2_AC_FLOW_POLARITY_HIGH

endif # TLK_UART2_FLOW_CONTROL

endif # UART2_AUTO_CONFIG


choice
    prompt "TX mode"
    default TLK_UART2_TX_BLOCKING

config TLK_UART2_TX_BLOCKING
    bool "Blocking"
    select TLK_UART_USE_BLOCKING

config TLK_UART2_TX_IRQ
    bool "Interrupt"
    select TLK_UART2_USE_IRQ
    depends on TLK_PLIC

config TLK_UART2_TX_DMA
    bool "DMA"
    select TLK_UART2_USE_DMA
    select TLK_UART2_USE_IRQ
    depends on TLK_DMA
    depends on TLK_PLIC

endchoice # TX mode


config TLK_UART2_TX_MODE
    string
    default "TLK_UART_XFER_BLOCKING" if TLK_UART2_TX_BLOCKING
    default "TLK_UART_XFER_IRQ" if TLK_UART2_TX_IRQ
    default "TLK_UART_XFER_DMA" if TLK_UART2_TX_DMA


choice
    prompt "RX mode"
    default TLK_UART2_RX_IRQ

config TLK_UART2_RX_IRQ
    bool "Interrupt"
    select TLK_UART2_USE_IRQ

config TLK_UART2_RX_DMA
    bool "DMA"
    select TLK_UART2_USE_DMA
    select TLK_UART2_USE_IRQ
    depends on TLK_DMA
    depends on TLK_PLIC

endchoice # RX mode


config TLK_UART2_RX_MODE
    string
    default "TLK_UART_XFER_BLOCKING" if TLK_UART2_RX_BLOCKING
    default "TLK_UART_XFER_IRQ" if TLK_UART2_RX_IRQ
    default "TLK_UART_XFER_DMA" if TLK_UART2_RX_DMA


if TLK_UART2_RX_DMA

choice
    prompt "RX DMA type"

config TLK_UART2_RX_DMA_FIXED
    bool "Word only"

config TLK_UART2_RX_DMA_WITH_TAIL
    bool "Word with manual tail read"
    depends on TLK_DMA_IRQ

endchoice # RX DMA type


config TLK_UART2_RX_DMA_MODE
    string
    default "TLK_UART_RX_DMA_FIXED" if TLK_UART2_RX_DMA_FIXED
    default "TLK_UART_RX_DMA_WITH_TAIL" if TLK_UART2_RX_DMA_WITH_TAIL

endif # TLK_UART2_RX_DMA


config TLK_UART2_FLOW_CONTROL
    bool "Use flow control"
    select TLK_UART_USE_FLOW_CONTROL


config TLK_UART_RTS_TRIG_LEVEL
   int "RTS trig level"
   default 5
   range 1 8
   depends on TLK_UART2_FLOW_CONTROL


if TLK_PM

config TLK_UART2_PM_DEVICE
    bool "Enable PM Support"
    default y
    select TLK_UART_USE_PM_DEVICE

config TLK_UART2_PREVENT_SLEEP
    bool "Prevent sleep if busy"

endif # TLK_PM

endif # TLK_UART2

endif # TLK_UART
```

## kconfig/TL721X/TL7218X_EVK/core/configs/Kconfig.wdt
```kconfig
menuconfig TLK_WDT
    bool "WDT"
    select TLK_STIMER_ADVANCED_MODE


if TLK_WDT

config TLK_WDT_STARTUP
    bool "Enable WDT at startup"

config TLK_WDT_STARTUP_TIMEOUT
    int "WDT startup timeout (ms)"
    depends on TLK_WDT_STARTUP
    default 5000

endif # TLK_WDT
```

## kconfig/TL721X/core/configs/Kconfig.gpio
```kconfig
menuconfig TLK_GPIO
    bool "GPIO"


if TLK_GPIO

config TLK_GPIO_USE_PORT
    def_bool n

menu "Select enabled ports"


config TLK_GPIO_PORT_0
    bool

config TLK_GPIO_PORT_A
    select TLK_GPIO_PORT_0
    select TLK_GPIO_USE_PORT
    bool "Enable GPIO port A"
    default y

config TLK_GPIO_PORT_1
    bool

config TLK_GPIO_PORT_B
    select TLK_GPIO_PORT_1
    select TLK_GPIO_USE_PORT
    bool "Enable GPIO port B"
    default y

config TLK_GPIO_PORT_2
    bool

config TLK_GPIO_PORT_C
    select TLK_GPIO_PORT_2
    select TLK_GPIO_USE_PORT
    bool "Enable GPIO port C"
    default y

config TLK_GPIO_PORT_3
    bool

config TLK_GPIO_PORT_D
    select TLK_GPIO_PORT_3
    select TLK_GPIO_USE_PORT
    bool "Enable GPIO port D"
    default y

config TLK_GPIO_PORT_4
    bool

config TLK_GPIO_PORT_E
    select TLK_GPIO_PORT_4
    select TLK_GPIO_USE_PORT
    bool "Enable GPIO port E"
    default y

config TLK_GPIO_PORT_5
    bool

config TLK_GPIO_PORT_F
    select TLK_GPIO_PORT_5
    select TLK_GPIO_USE_PORT
    bool "Enable GPIO port F"
    default y

endmenu


if TLK_PM

config TLK_GPIO_PM_DEVICE
    bool "Enable PM Support"
    default y

config TLK_GPIO_PREVENT_SLEEP
    bool "Prevent sleep if some output pin is enabled"

endif # TLK_PM

endif # TLK_GPIO
```
